#include "GPIODriver.h"

GPIODriver::GPIODriver(GPIO_TypeDef* segPorts[8], uint16_t segPins[8],
                       GPIO_TypeDef* digPorts[16], uint16_t digPins[16]) {
  for (int i = 0; i < 8; ++i) {
    segmentPorts[i] = segPorts[i];
    segmentPins[i] = segPins[i];
  }
  for (int i = 0; i < 16; ++i) {
    digitPorts[i] = digPorts[i];
    digitPins[i] = digPins[i];
  }
}

void GPIODriver::initialize() {
  __HAL_RCC_GPIOA_CLK_ENABLE();
  __HAL_RCC_GPIOB_CLK_ENABLE();

  GPIO_InitTypeDef GPIO_InitStruct = {0};

  GPIO_InitStruct.Mode = GPIO_MODE_OUTPUT_PP;
  GPIO_InitStruct.Pull = GPIO_NOPULL;
  GPIO_InitStruct.Speed = GPIO_SPEED_FREQ_LOW;

  for (int i = 0; i < 8; ++i) {
    GPIO_InitStruct.Pin = segmentPins[i];
    HAL_GPIO_Init(segmentPorts[i], &GPIO_InitStruct);
  }

  for (int i = 0; i < 16; ++i) {
    GPIO_InitStruct.Pin = digitPins[i];
    HAL_GPIO_Init(digitPorts[i], &GPIO_InitStruct);
  }



}

void GPIODriver::updateDisplay() {

  for (int i = 0; i < 16; i++) {
    HAL_GPIO_WritePin(digitPorts[i], digitPins[i], GPIO_PIN_SET);
  }

  if(!displayBuffer[currentDigit].active){
    currentDigit = (currentDigit + 1) % 16;
    return;
  }

  uint8_t digit = displayBuffer[currentDigit].digit;
  uint8_t segments = segmentMap[digit];


  for (int i = 0; i < 8; i++) {
    GPIO_PinState state = (segments & (1 << i)) ? GPIO_PIN_SET : GPIO_PIN_RESET;
    HAL_GPIO_WritePin(segmentPorts[i], segmentPins[i], state);
  }


  HAL_GPIO_WritePin(digitPorts[currentDigit], digitPins[currentDigit], GPIO_PIN_RESET);

  currentDigit = (currentDigit + 1) % 16;

}

void GPIODriver::clearDisplay() {
  for (int i = 0; i < 16; ++i) {
    HAL_GPIO_WritePin(digitPorts[i], digitPins[i], GPIO_PIN_SET);

  }

  for (int i = 0; i < 8; ++i) {
    HAL_GPIO_WritePin(segmentPorts[i], segmentPins[i], GPIO_PIN_SET);
    displayBuffer[i].digit = 0;
    displayBuffer[i].active = false;
  }


}
void GPIODriver::displayDigit(uint8_t digit, uint8_t position) {
    displayBuffer[position].digit = digit;
    displayBuffer[position].active = true;
}
